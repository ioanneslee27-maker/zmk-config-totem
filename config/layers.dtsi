/*=====================*/
/* Layer               */
/*=====================*/
#define BASE 0
#define NAVI 1
#define NUMB 2
#define SYMB 3
#define FUNC 4

/*=====================*/
/* Alias               */
/*=====================*/
#define __________ &trans

#define KP_LA0     &tlt FUNC LC(LG(LEFT))
#define KP_LH2     &kp LC(LG(RIGHT))
#define KP_LH1     &tlt NAVI SPACE
#define KP_LH0     &tlt SYMB RET

#define KP_RH0     &tlt SYMB BSPC
#define KP_RH1     &sk LSHFT
#define KP_RH2     &kp C_PP
#define KP_RA0     &tlt FUNC APOS

#define WIN_1      &kp LG(N1)
#define WIN_2      &kp LG(N2)
#define WIN_3      &kp LG(N3)
#define WIN_4      &kp LG(N4)
#define WIN_PREV   &kp LC(LG(LEFT))
#define WIN_NEXT   &kp LC(LG(RIGHT))
#define TAB_PREV   &kp LC(LS(TAB))
#define TAB_NEXT   &kp LC(TAB)

/*=====================*/
/* Keymap              */
/*=====================*/
ZMK_LAYER(base_layer, /*
╭────────────┬────────────┬────────────┬────────────┬────────────╮╭────────────┬────────────┬────────────┬────────────┬────────────╮
*/&kp Q        &kp W        &kp E        &kp R        &kp T         &kp Y        &kp U        &kp I        &kp O        &kp P     /*
├────────────┼────────────┼────────────┼────────────┼────────────┤├────────────┼────────────┼────────────┼────────────┼────────────┤
*/LX4(A)       LX3(S)       LX2(D)       LX1(F)       &kp G         &kp H        RX1(J)       RX2(K)       RX3(L)       RX4(SEMI) /*
├────────────┼────────────┼────────────┼────────────┼────────────┤├────────────┼────────────┼────────────┼────────────┼────────────┤
*/&kp Z        &kp X        &kp C        &kp V        &kp B         &kp N        &kp M        &M_COMMA     &M_DOT       &M_FSLH   /*
╰────────────┴────────────┴────────────┴────────────┴────────────╯╰────────────┴────────────┴────────────┴────────────┴────────────╯
╭────────────╮            ╭────────────┬────────────┬────────────╮╭────────────┬────────────┬────────────╮            ╭────────────╮
*/KP_LA0       &none        KP_LH2       KP_LH1       KP_LH0        KP_RH0       KP_RH1       KP_RH2       &none        KP_RA0    /*
╰────────────╯            ╰────────────┴────────────┴────────────╯╰────────────┴────────────┴────────────╯            ╰────────────╯
*/)

ZMK_LAYER(navi_layer, /*
╭────────────┬────────────┬────────────┬────────────┬────────────╮╭────────────┬────────────┬────────────┬────────────┬────────────╮
*/__________   __________   __________   __________   __________    __________   WIN_PREV     TAB_PREV     TAB_NEXT     WIN_NEXT  /*
├────────────┼────────────┼────────────┼────────────┼────────────┤├────────────┼────────────┼────────────┼────────────┼────────────┤
*/__________   __________   __________   __________   __________    __________   &kp LEFT     &kp DOWN     &kp UP       &kp RIGHT /*
├────────────┼────────────┼────────────┼────────────┼────────────┤├────────────┼────────────┼────────────┼────────────┼────────────┤
*/__________   __________   __________   __________   __________    __________   WIN_1        WIN_2        WIN_3        WIN_4     /*
╰────────────┴────────────┴────────────┴────────────┴────────────╯╰────────────┴────────────┴────────────┴────────────┴────────────╯
╭────────────╮            ╭────────────┬────────────┬────────────╮╭────────────┬────────────┬────────────╮            ╭────────────╮
*/__________   __________   __________   __________   __________    __________   __________   __________   __________   __________/*
╰────────────╯            ╰────────────┴────────────┴────────────╯╰────────────┴────────────┴────────────╯            ╰────────────╯
*/)

ZMK_LAYER(numb_layer, /*
╭────────────┬────────────┬────────────┬────────────┬────────────╮╭────────────┬────────────┬────────────┬────────────┬────────────╮
*/__________   __________   __________   __________   __________    __________   &kp N7       &kp N8       &kp N9       &kp N0    /*
├────────────┼────────────┼────────────┼────────────┼────────────┤├────────────┼────────────┼────────────┼────────────┼────────────┤
*/__________   __________   __________   __________   __________    __________   &kp N4       &kp N5       &kp N6       &kp N0   /*
├────────────┼────────────┼────────────┼────────────┼────────────┤├────────────┼────────────┼────────────┼────────────┼────────────┤
*/__________   __________   __________   __________   __________    __________   &kp N1       &kp N2       &kp N3       &kp N0    /*
╰────────────┴────────────┴────────────┴────────────┴────────────╯╰────────────┴────────────┴────────────┴────────────┴────────────╯
╭────────────╮            ╭────────────┬────────────┬────────────╮╭────────────┬────────────┬────────────╮            ╭────────────╮
*/__________   __________   __________   __________   __________    __________   __________   __________   __________   __________/*
╰────────────╯            ╰────────────┴────────────┴────────────╯╰────────────┴────────────┴────────────╯            ╰────────────╯
*/)

ZMK_LAYER(symb_layer, /*
╭────────────┬────────────┬────────────┬────────────┬────────────╮╭────────────┬────────────┬────────────┬────────────┬────────────╮
*/&kp GRAVE    &kp DLLR     &kp CARET    &kp PRCNT    __________    __________   __________   __________   __________   __________/*
├────────────┼────────────┼────────────┼────────────┼────────────┤├────────────┼────────────┼────────────┼────────────┼────────────┤
*/&kp TILDE    &kp MINUS    &kp PLUS     &kp EQUAL    &kp AT        __________   __________   __________   __________   __________/*
├────────────┼────────────┼────────────┼────────────┼────────────┤├────────────┼────────────┼────────────┼────────────┼────────────┤
*/&kp HASH     &kp FSLH     &kp STAR     &kp UNDER    __________    __________   __________   __________   __________   __________/*
╰────────────┴────────────┴────────────┴────────────┴────────────╯╰────────────┴────────────┴────────────┴────────────┴────────────╯
╭────────────╮            ╭────────────┬────────────┬────────────╮╭────────────┬────────────┬────────────╮            ╭────────────╮
*/__________   __________   __________   __________   __________    __________   __________   __________   __________   __________/*
╰────────────╯            ╰────────────┴────────────┴────────────╯╰────────────┴────────────┴────────────╯            ╰────────────╯
*/)

ZMK_LAYER(func_layer, /*
╭────────────┬────────────┬────────────┬────────────┬────────────╮╭────────────┬────────────┬────────────┬────────────┬────────────╮
*/__________   __________   __________   __________   __________    __________   __________   __________   __________   __________/*
├────────────┼────────────┼────────────┼────────────┼────────────┤├────────────┼────────────┼────────────┼────────────┼────────────┤
*/__________   __________   __________   __________   __________    __________  &kp C_VOL_DN  &kp C_MUTE  &kp C_VOL_UP  __________/*
├────────────┼────────────┼────────────┼────────────┼────────────┤├────────────┼────────────┼────────────┼────────────┼────────────┤
*/__________   __________   __________   __________   __________    __________   &kp C_PREV   &kp C_PP     &kp C_NEXT   __________/*
╰────────────┴────────────┴────────────┴────────────┴────────────╯╰────────────┴────────────┴────────────┴────────────┴────────────╯
╭────────────╮            ╭────────────┬────────────┬────────────╮╭────────────┬────────────┬────────────╮            ╭────────────╮
*/__________   __________   __________   __________   __________    __________   __________   __________   __________   __________/*
╰────────────╯            ╰────────────┴────────────┴────────────╯╰────────────┴────────────┴────────────╯            ╰────────────╯
*/)

/*=====================*/
/* Combo               */
/*=====================*/
/*
╭────────────┬────────────┬────────────┬────────────┬────────────╮╭────────────┬────────────┬────────────┬────────────┬────────────╮
│    LT4     │    LT3     |    LT2     &    LT1     │    LT0     ││    RT0     │    RT1     [    RT2     ]    RT3     │    RT4     │
├────────────┼────────────┼────────────┼────────────┼────────────┤├────────────┼────────────┼────────────┼────────────┼────────────┤
│    LM4    Del   LM3    Tab   LM2   Enter  LM1    Bspc  LM0     ││    RM0     {    RM1     (    RM2     )    RM3     }    RM4     │
├────────────┼────────────┼────────────┼────────────┼────────────┤├────────────┼────────────┼────────────┼────────────┼────────────┤
│    LB4     │    LB3     _    LB2     =    LB1     │    LB0     ││    RB0     │    RB1     <    RB2     >    RB3     │    RB4     │
╰────────────┴────────────┴────────────┴────────────┴────────────╯╰────────────┴────────────┴────────────┴────────────┴────────────╯
╭────────────╮            ╭────────────┬────────────┬────────────╮╭────────────┬────────────┬────────────╮            ╭────────────╮
│    LA0     │            │    LH2     │    LH1     │    LH0     ││    RH0     │    RH1     │    RH2     │            │    RA0     │
╰────────────╯            ╰────────────┴────────────┴────────────╯╰────────────┴────────────┴────────────╯            ╰────────────╯
*/
#define COMBO_TERM_FAST 18
#define COMBO_TERM_SLOW 30
#define COMBO_IDLE_FAST 150
#define COMBO_IDLE_SLOW 50
// Left horizontal
ZMK_COMBO(l_amps   , &kp AMPS       , LT1 LT2, BASE NAVI SYMB, COMBO_TERM_FAST, COMBO_IDLE_FAST)
ZMK_COMBO(l_pipe   , &kp PIPE       , LT2 LT3, BASE NAVI SYMB, COMBO_TERM_FAST, COMBO_IDLE_FAST)
ZMK_COMBO(l_bspc   , &kp BSPC       , LM0 LM1, BASE NAVI SYMB, COMBO_TERM_FAST, COMBO_IDLE_FAST)
ZMK_COMBO(l_ret    , LX12(RET)      , LM1 LM2, BASE NAVI SYMB, COMBO_TERM_FAST, COMBO_IDLE_FAST)
ZMK_COMBO(l_tab    , LX23(TAB)      , LM2 LM3, BASE NAVI SYMB, COMBO_TERM_FAST, COMBO_IDLE_FAST)
ZMK_COMBO(l_del    , LX34(DEL)      , LM3 LM4, BASE NAVI SYMB, COMBO_TERM_FAST, COMBO_IDLE_FAST)
ZMK_COMBO(l_esc    , LX13(ESC)      , LM1 LM3, BASE NAVI SYMB, COMBO_TERM_FAST, COMBO_IDLE_FAST)
ZMK_COMBO(l_equal  , &kp EQUAL      , LB1 LB2, BASE NAVI SYMB, COMBO_TERM_FAST, COMBO_IDLE_FAST)
ZMK_COMBO(l_under  , &kp UNDER      , LB2 LB3, BASE NAVI SYMB, COMBO_TERM_FAST, COMBO_IDLE_FAST)
// Right horizontal
ZMK_COMBO(r_lbkt   , &kp LBKT       , RT1 RT2, BASE NAVI SYMB, COMBO_TERM_FAST, COMBO_IDLE_FAST)
ZMK_COMBO(r_rbkt   , &kp RBKT       , RT2 RT3, BASE NAVI SYMB, COMBO_TERM_FAST, COMBO_IDLE_FAST)
ZMK_COMBO(r_lbrc   , &kp LBRC       , RM0 RM1, BASE NAVI SYMB, COMBO_TERM_FAST, COMBO_IDLE_FAST)
ZMK_COMBO(r_lpar   , RX12(LPAR)     , RM1 RM2, BASE NAVI SYMB, COMBO_TERM_FAST, COMBO_IDLE_FAST)
ZMK_COMBO(r_rpar   , RX23(RPAR)     , RM2 RM3, BASE NAVI SYMB, COMBO_TERM_FAST, COMBO_IDLE_FAST)
ZMK_COMBO(r_rbrc   , RX34(RBRC)     , RM3 RM4, BASE NAVI SYMB, COMBO_TERM_FAST, COMBO_IDLE_FAST)
ZMK_COMBO(r_lang   , RX13(LC(SPACE)), RM3 RM4, BASE NAVI SYMB, COMBO_TERM_FAST, COMBO_IDLE_FAST)
ZMK_COMBO(r_lt     , &kp LT         , RB1 RB2, BASE NAVI SYMB, COMBO_TERM_FAST, COMBO_IDLE_FAST)
ZMK_COMBO(r_gt     , &kp GT         , RB2 RB3, BASE NAVI SYMB, COMBO_TERM_FAST, COMBO_IDLE_FAST)
// Left vertical
ZMK_COMBO(l_equal  , &kp EQUAL      , LT1 LM1, BASE NAVI SYMB, COMBO_TERM_SLOW, COMBO_IDLE_SLOW)
ZMK_COMBO(l_under  , &kp UNDER      , LM1 LB1, BASE NAVI SYMB, COMBO_TERM_SLOW, COMBO_IDLE_SLOW)
ZMK_COMBO(l_plus   , &kp PLUS       , LT2 LM2, BASE NAVI SYMB, COMBO_TERM_SLOW, COMBO_IDLE_SLOW)
ZMK_COMBO(l_star   , &kp STAR       , LM2 LB2, BASE NAVI SYMB, COMBO_TERM_SLOW, COMBO_IDLE_SLOW)
ZMK_COMBO(l_minus  , &kp MINUS      , LT3 LM3, BASE NAVI SYMB, COMBO_TERM_SLOW, COMBO_IDLE_SLOW)
ZMK_COMBO(l_fslh   , &kp FSLH       , LM3 LB3, BASE NAVI SYMB, COMBO_TERM_SLOW, COMBO_IDLE_SLOW)

